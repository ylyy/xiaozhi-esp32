## sdkconfig.defaults
```kconfig
CONFIG_COMPILER_CXX_EXCEPTIONS=y
CONFIG_COMPILER_CXX_EXCEPTIONS_EMG_POOL_SIZE=1024

CONFIG_BOOTLOADER_COMPILER_OPTIMIZATION_PERF=y
CONFIG_BOOTLOADER_LOG_LEVEL_NONE=y
CONFIG_BOOTLOADER_SKIP_VALIDATE_ALWAYS=y
CONFIG_BOOTLOADER_APP_ROLLBACK_ENABLE=y

CONFIG_HTTPD_MAX_REQ_HDR_LEN=2048
CONFIG_HTTPD_MAX_URI_LEN=2048

CONFIG_PARTITION_TABLE_CUSTOM=y
CONFIG_PARTITION_TABLE_CUSTOM_FILENAME="partitions.csv"
CONFIG_PARTITION_TABLE_OFFSET=0x8000

ESP_TASK_WDT_TIMEOUT_S=10
CONFIG_FREERTOS_GENERATE_RUN_TIME_STATS=y
CONFIG_FREERTOS_USE_STATS_FORMATTING_FUNCTIONS=y

CONFIG_ESP_MAIN_TASK_STACK_SIZE=4096
CONFIG_MBEDTLS_DYNAMIC_BUFFER=y
CONFIG_MBEDTLS_SSL_KEEP_PEER_CERTIFICATE=n
CONFIG_ESP_WIFI_IRAM_OPT=n
CONFIG_ESP_WIFI_RX_IRAM_OPT=n
CONFIG_ESP_WIFI_DYNAMIC_RX_MGMT_BUFFER=y

CONFIG_CODEC_I2C_BACKWARD_COMPATIBLE=n

# LVGL 9.2.2

CONFIG_LV_OS_NONE=y
CONFIG_LV_USE_OS=0
CONFIG_LV_USE_CLIB_MALLOC=y
CONFIG_LV_USE_CLIB_STRING=y
CONFIG_LV_USE_CLIB_SPRINTF=y
CONFIG_LV_USE_IMGFONT=y

# Use compressed font
CONFIG_LV_FONT_FMT_TXT_LARGE=y
CONFIG_LV_USE_FONT_COMPRESSED=y
CONFIG_LV_USE_FONT_PLACEHOLDER=y

# Disable extra widgets to save flash size
CONFIG_LV_USE_ANIMIMG=n
CONFIG_LV_USE_CALENDAR=n
CONFIG_LV_USE_CALENDAR_HEADER_ARROW=n
CONFIG_LV_USE_CALENDAR_HEADER_DROPDOWN=n
CONFIG_LV_USE_CHART=n
CONFIG_LV_USE_KEYBOARD=n
CONFIG_LV_USE_LED=n
CONFIG_LV_USE_LIST=n
CONFIG_LV_USE_MENU=n
CONFIG_LV_USE_MSGBOX=n
CONFIG_LV_USE_SPAN=n
CONFIG_LV_USE_SPINBOX=n
CONFIG_LV_USE_SPINNER=n
CONFIG_LV_USE_TABVIEW=n
CONFIG_LV_USE_TILEVIEW=n
CONFIG_LV_USE_WIN=n

CONFIG_LV_BUILD_EXAMPLES=n

# 添加CSI功能配置
CONFIG_ESP_WIFI_CSI_ENABLED=y
CONFIG_ESP_WIFI_CSI_BUFFER_SIZE=128

# 添加蓝牙BLE相关配置
CONFIG_BT_ENABLED=y
CONFIG_BT_BLE_ENABLED=y
CONFIG_BT_BLUEDROID_ENABLED=y
CONFIG_BT_CLASSIC_ENABLED=n
CONFIG_BT_NIMBLE_ENABLED=n
CONFIG_BT_GATTC_ENABLE=y
CONFIG_BT_GATTS_ENABLE=n
CONFIG_BT_BLE_42_FEATURES_SUPPORTED=y
CONFIG_BT_BLE_50_FEATURES_SUPPORTED=y
CONFIG_BT_BLE_BLUFI_ENABLE=n
CONFIG_BT_CTRL_MODE_BLE_ONLY=y
CONFIG_BT_CTRL_MODE_BR_EDR_ONLY=n
CONFIG_BT_CTRL_MODE_BTDM=n
CONFIG_BT_CTRL_BLE_MAX_ACT=10
CONFIG_BT_CTRL_BLE_MAX_ACT_EFF=10
CONFIG_BT_CTRL_BLE_STATIC_ACL_TX_BUF_NB=0
CONFIG_BT_CTRL_PINNED_TO_CORE_0=y
CONFIG_BT_CTRL_HCI_MODE_VHCI=y
CONFIG_BT_CTRL_HCI_TL=1
CONFIG_BT_BLUEDROID_PINNED_TO_CORE_0=y
CONFIG_BT_BTU_TASK_STACK_SIZE=4096
CONFIG_BT_BLE_HOST_QUEUE_CONG_CHECK=n
CONFIG_BT_SMP_ENABLE=y
CONFIG_BT_BLE_ESTAB_LINK_CONN_TOUT=30
```

## sdkconfig.defaults.esp32c3
```kconfig
CONFIG_ESPTOOLPY_FLASHSIZE_16MB=y

# 添加蓝牙BLE相关配置
CONFIG_BT_ENABLED=y
CONFIG_BT_BLE_ENABLED=y
CONFIG_BT_BLUEDROID_ENABLED=y
CONFIG_BT_CLASSIC_ENABLED=n
CONFIG_BT_NIMBLE_ENABLED=n

# 蓝牙内存配置
CONFIG_BT_BLE_DYNAMIC_ENV_MEMORY=y
CONFIG_BT_BTU_TASK_STACK_SIZE=4096
CONFIG_BT_BLUEDROID_PINNED_TO_CORE_0=y
CONFIG_BT_BTC_TASK_STACK_SIZE=3072
CONFIG_BT_BLUEDROID_MEM_DEBUG=n

# 蓝牙控制器配置
CONFIG_BTDM_CTRL_MODE_BLE_ONLY=y
CONFIG_BTDM_CTRL_MODE_BR_EDR_ONLY=n
CONFIG_BTDM_CTRL_MODE_BTDM=n

# 增加蓝牙堆栈大小
CONFIG_BT_GATTC_ENABLE=y
CONFIG_BT_GATTC_CACHE_NVS_FLASH=y
CONFIG_BT_BLE_ACT_SCAN_REP_ADV_SCAN=y
CONFIG_BT_BLE_ESTAB_LINK_CONN_TOUT=30
```
